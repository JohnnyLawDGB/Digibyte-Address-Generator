## os/Config.in
```kconfig
source "$BR2_EXTERNAL_HOLDFAST_PATH/package/holdfast-node/Config.in"
source "$BR2_EXTERNAL_HOLDFAST_PATH/package/holdfast-vault/Config.in"
```

## os/configs/holdfast_qemu_defconfig
```kconfig
# HoldFast Vault userland on QEMU's generic arm64 machine, for boot tests.
# Same root filesystem, tool and no-network kernel options as the Pi image;
# only the board support differs.
BR2_aarch64=y
BR2_GLOBAL_PATCH_DIR="board/qemu/patches"
BR2_TOOLCHAIN_EXTERNAL=y
BR2_TOOLCHAIN_EXTERNAL_BOOTLIN=y
BR2_TOOLCHAIN_EXTERNAL_BOOTLIN_AARCH64_GLIBC_STABLE=y
BR2_DOWNLOAD_FORCE_CHECK_HASHES=y
BR2_BACKUP_SITE=""
BR2_REPRODUCIBLE=y
BR2_TARGET_GENERIC_HOSTNAME="holdfast-vault"
BR2_TARGET_GENERIC_ISSUE="HoldFast Vault"
# BR2_TARGET_GENERIC_GETTY is not set
BR2_SYSTEM_DHCP=""
BR2_ROOTFS_OVERLAY="$(BR2_EXTERNAL_HOLDFAST_PATH)/board/holdfast/rootfs-overlay"
BR2_ROOTFS_POST_BUILD_SCRIPT="$(BR2_EXTERNAL_HOLDFAST_PATH)/board/holdfast/post-build.sh"
BR2_LINUX_KERNEL=y
BR2_LINUX_KERNEL_NEEDS_HOST_OPENSSL=y
BR2_TARGET_ROOTFS_CPIO=y
BR2_TARGET_ROOTFS_INITRAMFS=y
# BR2_TARGET_ROOTFS_TAR is not set
BR2_PACKAGE_HOLDFAST_NODE=y
BR2_PACKAGE_HOLDFAST_VAULT=y
BR2_ROOTFS_POST_SCRIPT_ARGS="ttyAMA0"
BR2_LINUX_KERNEL_CUSTOM_VERSION=y
BR2_LINUX_KERNEL_CUSTOM_VERSION_VALUE="6.18.7"
BR2_LINUX_KERNEL_USE_CUSTOM_CONFIG=y
BR2_LINUX_KERNEL_CUSTOM_CONFIG_FILE="board/qemu/aarch64-virt/linux.config"
BR2_LINUX_KERNEL_CONFIG_FRAGMENT_FILES="$(BR2_EXTERNAL_HOLDFAST_PATH)/board/holdfast/linux-no-network.fragment"
```

## os/configs/holdfast_rpi_defconfig
```kconfig
# HoldFast Vault for Raspberry Pi 3 B, 3 B+, 4 B and Pi 400 (64-bit).
# One image: the boot partition carries both firmware sets and all four
# device trees, and the Pi's own boot ROM picks the right ones.
BR2_aarch64=y
BR2_ARM_FPU_VFPV4=y
BR2_GLOBAL_PATCH_DIR="board/raspberrypi/patches"
BR2_TOOLCHAIN_EXTERNAL=y
BR2_TOOLCHAIN_EXTERNAL_BOOTLIN=y
BR2_TOOLCHAIN_EXTERNAL_BOOTLIN_AARCH64_GLIBC_STABLE=y
BR2_DOWNLOAD_FORCE_CHECK_HASHES=y
BR2_REPRODUCIBLE=y
BR2_TARGET_GENERIC_HOSTNAME="holdfast-vault"
BR2_TARGET_GENERIC_ISSUE="HoldFast Vault"
# BR2_TARGET_GENERIC_GETTY is not set
BR2_SYSTEM_DHCP=""
BR2_ROOTFS_OVERLAY="$(BR2_EXTERNAL_HOLDFAST_PATH)/board/holdfast/rootfs-overlay"
BR2_ROOTFS_POST_BUILD_SCRIPT="$(BR2_EXTERNAL_HOLDFAST_PATH)/board/holdfast/post-build.sh"
BR2_LINUX_KERNEL=y
BR2_LINUX_KERNEL_NEEDS_HOST_OPENSSL=y
BR2_TARGET_ROOTFS_CPIO=y
BR2_TARGET_ROOTFS_INITRAMFS=y
# BR2_TARGET_ROOTFS_TAR is not set
BR2_PACKAGE_HOLDFAST_NODE=y
BR2_PACKAGE_HOLDFAST_VAULT=y
BR2_ROOTFS_POST_SCRIPT_ARGS="tty1"
BR2_ROOTFS_POST_IMAGE_SCRIPT="$(BR2_EXTERNAL_HOLDFAST_PATH)/board/holdfast/rpi/post-image.sh"
BR2_LINUX_KERNEL_CUSTOM_TARBALL=y
BR2_LINUX_KERNEL_CUSTOM_TARBALL_LOCATION="$(call github,raspberrypi,linux,21b410140c47ffab5668399f6f143c7d7b935c8b)/linux-21b410140c47ffab5668399f6f143c7d7b935c8b.tar.gz"
BR2_LINUX_KERNEL_DEFCONFIG="bcm2711"
BR2_LINUX_KERNEL_CONFIG_FRAGMENT_FILES="$(BR2_EXTERNAL_HOLDFAST_PATH)/board/holdfast/linux-no-network.fragment $(BR2_EXTERNAL_HOLDFAST_PATH)/board/holdfast/linux-usb-stick.fragment $(BR2_EXTERNAL_HOLDFAST_PATH)/board/holdfast/rpi/linux-console.fragment"
BR2_LINUX_KERNEL_DTS_SUPPORT=y
BR2_LINUX_KERNEL_INTREE_DTS_NAME="broadcom/bcm2710-rpi-3-b broadcom/bcm2710-rpi-3-b-plus broadcom/bcm2711-rpi-4-b broadcom/bcm2711-rpi-400"
BR2_PACKAGE_RPI_FIRMWARE=y
BR2_PACKAGE_RPI_FIRMWARE_BOOTCODE_BIN=y
BR2_PACKAGE_RPI_FIRMWARE_VARIANT_PI=y
BR2_PACKAGE_RPI_FIRMWARE_VARIANT_PI4=y
BR2_PACKAGE_RPI_FIRMWARE_INSTALL_DTB_OVERLAYS=y
BR2_PACKAGE_RPI_FIRMWARE_CONFIG_FILE="$(BR2_EXTERNAL_HOLDFAST_PATH)/board/holdfast/rpi/config.txt"
BR2_PACKAGE_RPI_FIRMWARE_CMDLINE_FILE="$(BR2_EXTERNAL_HOLDFAST_PATH)/board/holdfast/rpi/cmdline.txt"
BR2_PACKAGE_HOST_DOSFSTOOLS=y
BR2_PACKAGE_HOST_GENIMAGE=y
BR2_PACKAGE_HOST_MTOOLS=y
```

## os/package/holdfast-node/Config.in
```kconfig
config BR2_PACKAGE_HOLDFAST_NODE
	bool "holdfast-node"
	depends on BR2_aarch64
	depends on BR2_TOOLCHAIN_USES_GLIBC
	depends on BR2_INSTALL_LIBSTDCPP
	help
	  The official Node.js release binary for linux-arm64, pinned
	  by the SHA-256 published in nodejs.org's SHASUMS256.txt.
	  Only the `node` executable is installed: no npm, no headers.
```

## os/package/holdfast-vault/Config.in
```kconfig
config BR2_PACKAGE_HOLDFAST_VAULT
	bool "holdfast-vault"
	depends on BR2_PACKAGE_HOLDFAST_NODE
	help
	  The dgb-coldprep single-file bundle from this repository's
	  dist/ directory, checked against dist/SHA256SUMS at build
	  time, plus the console session that replaces a login shell.
```
